## example/V2.2/ESP_IDF/sdkconfig.defaults
```kconfig
# CrowPanel ESP32 3.5-inch HMI (hardware revision v2.2)
CONFIG_PARTITION_TABLE_SINGLE_APP_LARGE=y
CONFIG_FREERTOS_HZ=1000

# CrowPanel ESP32-WROVER external PSRAM.
CONFIG_SPIRAM=y
CONFIG_SPIRAM_MODE_QUAD=y
CONFIG_SPIRAM_TYPE_AUTO=y
CONFIG_SPIRAM_SPEED_40M=y
CONFIG_SPIRAM_USE_MALLOC=y
CONFIG_SPIRAM_MALLOC_RESERVE_INTERNAL=32768

CONFIG_TFT_ILI9488_DRIVER=y
CONFIG_TFT_SPI=y
CONFIG_TFT_VSPI_PORT=y
CONFIG_TFT_MISO=33
CONFIG_TFT_MOSI=13
CONFIG_TFT_SCLK=14
CONFIG_TFT_SPI_FREQUENCY=27000000
CONFIG_TFT_SPI_READ_FREQ=20000000
CONFIG_TFT_CS=15
CONFIG_TFT_DC=2
CONFIG_TFT_RST=-1
CONFIG_ENABLE_BL=y
CONFIG_TFT_BL=27
CONFIG_TFT_BACKLIGHT_ON_HIGH=y

CONFIG_ENABLE_TOUCH=y
CONFIG_TOUCH_CS=12
CONFIG_SPI_TOUCH_FREQUENCY=2500000

# The application does not use LVGL's bundled examples or demos.
CONFIG_LV_BUILD_EXAMPLES=n
CONFIG_LV_FONT_MONTSERRAT_18=y
```
